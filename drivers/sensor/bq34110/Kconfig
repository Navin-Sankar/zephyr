## drivers/sensor/bq34110/Kconfig
```kconfig
# Copyright (c) 2020 Linumiz
# SPDX-License-Identifier: Apache-2.0

menuconfig BQ34110
	bool "BQ34110 Fuel Gauge"
	depends on I2C
	help
	  Enable I2C-based driver for BQ34110 Fuel Gauge.

if BQ34110

choice BQ34110_TRIGGER_MODE
	prompt "Trigger mode"
	default BQ34110_TRIGGER_NONE
	help
	  Specify the type of triggering to be used by the driver.

config BQ34110_TRIGGER_NONE
	bool "No trigger"

config BQ34110_TRIGGER_GLOBAL_THREAD
	bool "Use global thread"
	depends on GPIO
	select BQ34110_TRIGGER

config BQ34110_TRIGGER_OWN_THREAD
	bool "Use own thread"
	depends on GPIO
	select BQ34110_TRIGGER

endchoice # BQ34110_TRIGGER_MODE

config BQ34110_TRIGGER
	bool

config BQ34110_THREAD_PRIORITY
	int "Thread priority"
	depends on BQ34110_TRIGGER_OWN_THREAD
	default 10
	help
	  Priority of thread used by the driver to handle interrupts.

config BQ34110_THREAD_STACK_SIZE
	int "Thread stack size"
	depends on BQ34110_TRIGGER_OWN_THREAD
	default 1024
	help
	  Stack size of thread used by the driver to handle interrupts.

endif # BQ34110
```
